## switch/main/Kconfig.projbuild
```kconfig
menu "Example Configuration"

    config ESP_WIFI_SSID
        string "WiFi SSID"
        default "hetianqi"
        help
            SSID (network name) for the example to connect to.

    config ESP_WIFI_PASSWORD
        string "WiFi Password"
        default "12345678"
        help
            WiFi password (WPA or WPA2) for the example to use.

    config FACTORY_TEST_SSID
        string "factory test ssid"
        default "livolo_mdev_test1"
        help
            factory test ssid.

    choice ESP_POWER_SAVE_MODE
        prompt "power save mode"
        default EXAMPLE_POWER_SAVE_MIN_MODEM
        help
            Power save mode for the esp8266 to use. Modem sleep mode includes minimum and maximum power save modes.
            In minimum/maximum power save mode, station wakes up every DTIM to receive beacon. Broadcast data will not be
            lost because it is transmitted after DTIM. However, it can not save much more power if DTIM is short
            for DTIM is determined by AP.

        config EXAMPLE_POWER_SAVE_NONE
            bool "none"
        config EXAMPLE_POWER_SAVE_MIN_MODEM
            bool "minimum modem"
        config EXAMPLE_POWER_SAVE_MAX_MODEM
            bool "maximum modem"
    endchoice

    choice LIVOLO_WIFI_SWITCH_NUM
        prompt "livolo wifi switch num"
        default LIVOLO_WIFI_SWITCH_3W

        help
            livolo wifi switch num, you have three choices: 1_way, 2_way, 3_way.

        config LIVOLO_WIFI_SWITCH_1W
            bool "1_way"
        config LIVOLO_WIFI_SWITCH_2W
            bool "2_way"
        config LIVOLO_WIFI_SWITCH_3W
            bool "3_way"
    endchoice
endmenu
```
